## main/Kconfig.projbuild
```kconfig
menu "Smart Intercom Configuration"

    menu "GPIO Configuration"
        config INTERCOM_RING_GPIO
            int "Ring detection GPIO"
            default 2
            help
                GPIO pin connected to optocoupler output (active LOW when ringing).

        config INTERCOM_UNLOCK_GPIO
            int "Unlock relay GPIO"
            default 22
            help
                GPIO pin connected to PhotoMOS relay control (active HIGH).
    endmenu

    menu "LED Configuration"
        config INTERCOM_LED_ENABLED
            bool "Enable status LED"
            default y
            help
                Enable the status LED. Disable for boards without an LED.

        config INTERCOM_LED_GPIO
            int "LED GPIO pin"
            default 19
            depends on INTERCOM_LED_ENABLED
            help
                GPIO pin for status LED (active-low, red LED).

        config INTERCOM_LED_BRIGHTNESS
            int "LED brightness (unused, for API compatibility)"
            default 255
            range 1 255
            depends on INTERCOM_LED_ENABLED
            help
                Unused for simple GPIO LED. Kept for API compatibility.
    endmenu

    menu "Timing Configuration"
        config INTERCOM_UNLOCK_PULSE_MS
            int "Unlock pulse duration (ms)"
            default 5000
            help
                How long to activate the door unlock relay.

        config INTERCOM_RING_DEBOUNCE_MS
            int "Ring debounce time (ms)"
            default 30
            help
                Debounce time for ring signal detection.

        config INTERCOM_RING_COOLDOWN_MS
            int "Ring cooldown time (ms)"
            default 2500
            help
                Minimum time between ring events.

        config INTERCOM_RING_HOLD_MS
            int "Ring hold time in HomeKit (ms)"
            default 15000
            help
                How long occupancy stays active in HomeKit after a ring.

        config INTERCOM_AUTO_RELOCK_SEC
            int "Auto-relock time (seconds)"
            default 4
            help
                Time after which Matter lock state returns to Locked.
    endmenu

endmenu
```
